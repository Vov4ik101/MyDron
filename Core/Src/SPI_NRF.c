#include "SPI_NRF.h"

//Примерная задержка
void delay_us_loop(uint32_t us) {
	/*
    // Константу 168 нужно подобрать экспериментально для вашего МК и частоты
    for (uint32_t i = 0; i < us * 3; i++) {
        __NOP(); // Инструкция "нет операции"
    }
     */
	DWT_Delay(us);
}

//Сбросить вывод CE
static void SPI_CE_Low(void) {
    LL_GPIO_ResetOutputPin(CE_GPIO_Port, CE_Pin);
}
//Установить вывод CE
static void SPI_CE_High(void) {
    LL_GPIO_SetOutputPin(CE_GPIO_Port, CE_Pin);
}

// === НИЗКОУРОВНЕВЫЕ ФУНКЦИИ SPI (LL) ===

static uint8_t SPI_Transfer(uint8_t data) {
    // Ожидание готовности TX буфера
    while (!LL_SPI_IsActiveFlag_TXE(SPI1));
    // Отправка данных
    LL_SPI_TransmitData8(SPI1, data);
    // Ожидание завершения приёма
    while (!LL_SPI_IsActiveFlag_RXNE(SPI1));
    return LL_SPI_ReceiveData8(SPI1);
}
/************************************************************************************
						ЧТЕНИЕ ОДНОБАЙТНОГО РЕГИСТРА NRF24L01
************************************************************************************/
uint8_t read_reg_NRF24(uint8_t reg){
	uint8_t data;
	LL_GPIO_ResetOutputPin(CSN_GPIO_Port,CSN_Pin );
	data = SPI_Transfer(reg);													// Передача команды и считывание регистра STATUS
	if (reg != STATUS){															// Если требуется считать не регистр STATUS,
		data = SPI_Transfer(NOP);												// то регистр считывается следующим байтом
	}
	LL_GPIO_SetOutputPin(CSN_GPIO_Port,CSN_Pin );
	return data;
}

/************************************************************************************
						ЗАПИСЬ ОДНОБАЙТНОГО РЕГИСТРА NRF24L01
************************************************************************************/
void write_reg_NRF24(uint8_t address, uint8_t data){
	LL_GPIO_ResetOutputPin(CSN_GPIO_Port,CSN_Pin );
	address |= W_REGISTER;														// Наложение маски для записи
	SPI_Transfer(address);														// Передача адреса на запись
	SPI_Transfer(data);															// Передача байта данных на запись
	LL_GPIO_SetOutputPin(CSN_GPIO_Port,CSN_Pin );
}

/************************************************************************************
						ОТПРАВКА ОДНОБАЙТНОЙ КОМАНДЫ NRF24L01
FLUSH_TX - команда очистки содержимого регистра передатчика
FLUSH_RX - команда очистки содержимого регистра приемника
************************************************************************************/
void send_cmd_NRF24(uint8_t cmd){
	LL_GPIO_ResetOutputPin(CSN_GPIO_Port,CSN_Pin );
	SPI_Transfer(cmd);																// Передача однобайтной команды
	LL_GPIO_SetOutputPin(CSN_GPIO_Port,CSN_Pin );
}

/************************************************************************************
						СБРОС РАЗРЯДА В ОДНОБАЙТНОМ РЕГИСТРЕ
************************************************************************************/
void clr_bit_reg_NRF24(uint8_t address, uint8_t bit){
	uint8_t data;
	data = read_reg_NRF24(address);													// Считывание
	data &= ~(1<<bit);																// Наложение маски
	write_reg_NRF24(address, data);													// Запись
}


/************************************************************************************
						УСТАНОВКА РАЗРЯДА В ОДНОБАЙТНОМ РЕГИСТРЕ
************************************************************************************/
void set_bit_reg_NRF24(uint8_t address, uint8_t bit){
	uint8_t data;
	data = read_reg_NRF24(address);													// Считывание
	data |= (1<<bit);																// Наложение маски
	write_reg_NRF24(address, data);													// Запись
}


/************************************************************************************
		ЗАПИСЬ ДАННЫХ В ТРЕХУРОВНЕВЫЙ БУФЕР ПЕРЕДАТЧИКА TX FIFO NRF24L01
************************************************************************************/
uint8_t write_FIFO(uint8_t data[DATA_SIZE]){
	uint8_t i=0;																	// Переменная элементов массива
	uint8_t count = DATA_SIZE;														// Счетчик величины массива
	LL_GPIO_ResetOutputPin(CSN_GPIO_Port,CSN_Pin );
	SPI_Transfer(W_TX_PAYLOAD);														// Команда записи байт данных в буфер
	while(count--){
		SPI_Transfer(data[i]);														// Передача байт данных из массива данных data в буфер FIFO NRF24L01
		i++;
	}
	LL_GPIO_SetOutputPin(CSN_GPIO_Port,CSN_Pin );
	return i; 																		//Возвращаем кол-во переданных байт
}


/************************************************************************************
		ЧТЕНИЕ ДАННЫХ ИЗ ТРЕХУРОВНЕВОГО БУФЕРА ПРИЕМНИКА RX FIFO NRF24L01
************************************************************************************/
uint8_t read_FIFO(uint8_t data[DATA_SIZE]){
	uint8_t status=ERR;
	set_bit_reg_NRF24(STATUS, RX_DR);												// Сброс флага успешного приема пакета
	LL_GPIO_ResetOutputPin(CSN_GPIO_Port,CSN_Pin );
	SPI_Transfer(R_RX_PAYLOAD);														// Команда чтения данных из буфера
	for (uint8_t i=0; i<DATA_SIZE; i++){											// Цикл записи считанных DATA_SIZE байт в массив data[]
		data[i] = SPI_Transfer(NOP);
	}
	LL_GPIO_SetOutputPin(CSN_GPIO_Port,CSN_Pin );
	if ( (read_reg_NRF24(FIFO_STATUS) & (1<<RX_EMPTY)) != 0)						// Если FIFO_STATUS.RX_EMPTY == 1, то в буфер приемника пуст
		status = FIFO_EMPTY;														// Буфер приемника пуст
	else
		status = FIFO_NOT_EMPTY;													// В буфере приемника есть непрочитанные данные
	return status;
}


/************************************************************************************
							ПЕРЕХОД В РЕЖИМ ПРИЕМА NRF24L01
************************************************************************************/
void rx_mode_NRF24(void){
	set_bit_reg_NRF24(CONFIG, PRIM_RX);												// Для перехода в режим приема CONFIG.PRIM_RX = 1
	SPI_CE_High();																	// Режим приема сохраняется, пока СЕ = 1
	delay_us_loop(135);																	// Задержка на переход в режим приема
}

/************************************************************************************
							ПЕРЕХОД В РЕЖИМ ПЕРЕДАЧИ NRF24L01
************************************************************************************/
void tx_mode_NRF24(void){
	SPI_CE_Low();																	// Переход в режим Standby-I
	clr_bit_reg_NRF24(CONFIG, PRIM_RX);												// Сброс бита CONFIG.PRIM_RX для перехода в режим передачи
	SPI_CE_High();																	// Импульс на выводе CE для запуска режима передачи
	delay_us_loop(20);
	SPI_CE_Low();
	delay_us_loop(135);																// Задержка на переход в режим передачи
}


/************************************************************************************
					ОЧИСТКА ФЛАГОВ ПРЕРЫВАНИЙ В РЕГИСТРЕ STATUS
************************************************************************************/
void clear_flags(void){
	uint8_t flags;
	flags = read_reg_NRF24(STATUS);													// Считывание флагов прерываний
	write_reg_NRF24(STATUS, flags);													// Сброс считанных флагов прерываний
}


/************************************************************************************
				ОТПРАВКА БАЙТ ДАННЫХ NRF24L01 И ПЕРЕКЛЮЧЕНИЕ НА ПРИЕМ
************************************************************************************/
uint8_t send_data_NRF24(uint8_t data[DATA_SIZE]){
	uint8_t status=ERR;
	send_cmd_NRF24(FLUSH_TX);														// Очистка буфера передатчика
	set_bit_reg_NRF24(STATUS, TX_DS);												// Сброс флага успешной отправки пакета
	set_bit_reg_NRF24(STATUS, MAX_RT);												// Сброс флага максимального числа попыток отправки пакета
	write_FIFO(data);																// Запись в буфер FIFO отправляемой информации

	tx_mode_NRF24();																// Запуск отправки байт данных из буфера
	while ( (read_reg_NRF24(STATUS) & (1<<TX_DS|1<<MAX_RT)) == 0 ) {}				// Ожидание установки бита успешной передачи TX_DS или максимального числа попыток передачи MAX_RT

	if ((read_reg_NRF24(STATUS) & (1<<TX_DS)) != 0)									// Проверка флага успешной отправки пакета
		status = OK;																// Если TX_DS = 1, то было принято подтверждение успешной отправки пакета
	else
		status = ERR;																// Если TX_DS = 0, то не было принято подтверждение успешной отправки пакета

	rx_mode_NRF24();																// Переключение на прием
	return status;
}

/************************************************************************************
				ОТПРАВКА нескольких байт ДАННЫХ NRF24L01 И ПЕРЕКЛЮЧЕНИЕ НА ПРИЕМ
************************************************************************************/
uint8_t send_dataFlow_NRF24(uint8_t data[DATA_SIZE], uint8_t Len){
	uint8_t status=ERR;
	send_cmd_NRF24(FLUSH_TX);														// Очистка буфера передатчика
	set_bit_reg_NRF24(STATUS, TX_DS);												// Сброс флага успешной отправки пакета
	set_bit_reg_NRF24(STATUS, MAX_RT);												// Сброс флага максимального числа попыток отправки пакета

//Запись данных в массив
			uint8_t i=0;																	// Переменная элементов массива
			uint8_t count = Len;														// Счетчик величины массива
			LL_GPIO_ResetOutputPin(CSN_GPIO_Port,CSN_Pin );
			SPI_Transfer(W_TX_PAYLOAD);														// Команда записи байт данных в буфер
			while(count--){
				SPI_Transfer(data[i]);														// Передача байт данных из массива данных data в буфер FIFO NRF24L01
				i++;
			}
			LL_GPIO_SetOutputPin(CSN_GPIO_Port,CSN_Pin );


	tx_mode_NRF24();																// Запуск отправки байт данных из буфера
	while ( (read_reg_NRF24(STATUS) & (1<<TX_DS|1<<MAX_RT)) == 0 ) {}				// Ожидание установки бита успешной передачи TX_DS или максимального числа попыток передачи MAX_RT

	if ((read_reg_NRF24(STATUS) & (1<<TX_DS)) != 0)									// Проверка флага успешной отправки пакета
		status = OK;																// Если TX_DS = 1, то было принято подтверждение успешной отправки пакета
	else
		status = ERR;																// Если TX_DS = 0, то не было принято подтверждение успешной отправки пакета

	rx_mode_NRF24();																// Переключение на прием
	return status;
}

/************************************************************************************
					ЗАПИСЬ АДРЕСА ДЛЯ ПЕРЕДАЧИ ПАКЕТА ДАННЫХ
************************************************************************************/
void set_tx_addr(uint8_t address[5]){
	LL_GPIO_ResetOutputPin(CSN_GPIO_Port,CSN_Pin );													// Запись адреса из 5 байт в регистр адреса передачи
	SPI_Transfer(TX_ADDR | W_REGISTER);											// Передача команды записи адреса из 5 байт в регистр адреса передачи
	for (uint8_t i=0; i<5; i++){
		SPI_Transfer(address[i]);												// Передача 5 байт адреса в регистр адреса
	}
	LL_GPIO_SetOutputPin(CSN_GPIO_Port,CSN_Pin );
	LL_GPIO_ResetOutputPin(CSN_GPIO_Port,CSN_Pin );													// Запись адреса из 5 байт в регистр приема данных канала 0 (для приема подтверждения успешности передачи)
	SPI_Transfer(RX_ADDR_P0 | W_REGISTER);										// Передача команды для записи адреса в регистр адреса канала 0
	for (uint8_t i=0; i<5; i++){
		SPI_Transfer(address[i]);												// Передача 5 байт адреса в регистр адреса
	}
	LL_GPIO_SetOutputPin(CSN_GPIO_Port,CSN_Pin );
}

/************************************************************************************
					ЗАПИСЬ АДРЕСА ДЛЯ ПРИЕМА ПАКЕТА ДАННЫХ
************************************************************************************/
void set_rx_addr(uint8_t address[5]){
	LL_GPIO_ResetOutputPin(CSN_GPIO_Port,CSN_Pin );													// Запись адреса из 5 байт в приема данных канала 1 (канал 1 - канал для приема данных)
	SPI_Transfer(RX_ADDR_P1 | W_REGISTER);										// Передача команды для записи адреса из 5 байт в приема данных канала 1
	for (uint8_t i=0; i<5; i++){
		SPI_Transfer(address[i]);												// Передача 5 байт адреса в регистр адреса
	}
	LL_GPIO_SetOutputPin(CSN_GPIO_Port,CSN_Pin );
}

/************************************************************************************
						ИНИЦИАЛИЗАЦИЯ МОДУЛЯ NRF24L01
************************************************************************************/
void init_NRF24L01 (void){
	LL_GPIO_ResetOutputPin(CSN_GPIO_Port,CSN_Pin );													// Запрещение обмена SPI
	SPI_CE_Low();														// Запрещение выхода из режима Standby-I

	HAL_Delay(100);																	// Задержка после подачи питания (100 мс)

	send_cmd_NRF24(FLUSH_TX);														// Очистка буфера передатчика
	send_cmd_NRF24(FLUSH_RX);														// Очистка буфера приемника

	clear_flags();																	// Очистка флагов прерываниий в регистре STATUS

	clr_bit_reg_NRF24(CONFIG, MASK_RX_DR);											// Включение прерывания на IRQ по приему пакета (0-включено, 1-выключено)
	set_bit_reg_NRF24(CONFIG, MASK_TX_DS);											// Запрет прерывания по передаче посылки
	set_bit_reg_NRF24(CONFIG, MASK_MAX_RT);											// Запрет прерывания по ошибке передачи

	write_reg_NRF24(RX_PW_P0, DATA_SIZE);											// Количество принимаемых байт данных канала 0 (передающая сторона ОБЯЗАТЕЛЬНО должна передавать ТОЖЕ САМОЕ КОЛИЧЕСТВО БАЙТ!)
	write_reg_NRF24(RX_PW_P1, DATA_SIZE);											// Количество принимаемых байт данных канала 1 (передающая сторона ОБЯЗАТЕЛЬНО должна передавать ТОЖЕ САМОЕ КОЛИЧЕСТВО БАЙТ!)

	clr_bit_reg_NRF24(RF_SETUP, RF_DR_HIGH);										// Снижение скорости до 250kbps для лучшего приема (RF_DR_LOW = 1, RF_DR_HIGH = 0 – 250kbps)
	set_bit_reg_NRF24(RF_SETUP, RF_DR_LOW);

	set_bit_reg_NRF24(RF_SETUP, 0);													// НАСТРОЙКА ДЛЯ SI24R01: установка нулевого бита в 1 для увеличения мощности передатчика до 5 мВт
	write_reg_NRF24(SETUP_RETR, 0x4F);												// Время ожидания повторной передачи 1 мс. Максимальное число повторов передачи (15 повторов)

	write_reg_NRF24(RF_CH, FREQ_CHANNEL);											// Задание номера канала для обмена данными

	tx_default_addr(TX_ADDRESS);													// Задание адреса передачи
	rx_default_addr(RX_ADDRESS);													// Задание адреса приема (для канала 1)

	set_bit_reg_NRF24(CONFIG, PWR_UP);												// Выведение из неактивного режима Power Down в рабочий режим Standby-I

	delay_us_loop(5);																// Задержка перед переходом в Standby-I

	rx_mode_NRF24();																// Переключение в режим приема

}
